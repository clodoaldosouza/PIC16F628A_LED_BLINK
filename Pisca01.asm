#INCLUDE 	<P16F628A.INC>
#DEFINE		BANK0	BCF		STATUS,RP0
#DEFINE		BANK1	BSF		STATUS,RP0
			__CONFIG   _CP_OFF & _WDT_OFF & _XT_OSC
			ERRORLEVEL -302
			CBLOCK 0x20
					COUNT
			ENDC
			ORG		0X00
			GOTO	INICIO
			ORG		0X04
INTSAI
			RETFIE
INICIO
			BANK0
			CLRF	PORTA
			CLRF	PORTB
			BANK1
			MOVLW	B'11111111'
			MOVWF	TRISA
			MOVLW	B'00000000'
			MOVWF	TRISB
			MOVLW	B'10000100'
			MOVWF	OPTION_REG
			BANK0
			MOVLW	0
			MOVWF	PORTB
MAIN
			BSF		PORTB,0
			CALL	DELAY1S
			BCF		PORTB,0
			CALL	DELAY1S
			GOTO	MAIN
DELAY1S
			MOVLW	.250
			MOVWF	COUNT
			MOVLW	.131
			MOVWF	TMR0
DELAY
			BTFSS	INTCON, T0IF
			GOTO	$-1
			BCF		INTCON, T0IF
			MOVLW	.131
			MOVWF	TMR0
			DECFSZ	COUNT,F
			GOTO	DELAY
			RETURN
END

